## ESP32-C3-SENSOR-NODE-RUST/sdkconfig.defaults
```kconfig
 # Rust main task stack sizes
CONFIG_ESP_MAIN_TASK_STACK_SIZE=8192
CONFIG_ESP_SYSTEM_EVENT_TASK_STACK_SIZE=4096
CONFIG_FREERTOS_IDLE_TASK_STACKSIZE=4096
CONFIG_PTHREAD_TASK_STACK_SIZE_DEFAULT=4096

# ================================================================
# PARTITION TABLE & MEMORY
# ================================================================
# CONFIG_PARTITION_TABLE_CUSTOM=y
# CONFIG_PARTITION_TABLE_CUSTOM_FILENAME="partitions.csv"
# CONFIG_PARTITION_TABLE_FILENAME="partitions.csv"
# CONFIG_PARTITION_TABLE_OFFSET=0x8000

CONFIG_ESP_HTTP_CLIENT_ENABLE_HTTPS=y
CONFIG_MBEDTLS_CERTIFICATE_BUNDLE=y
CONFIG_MBEDTLS_CERTIFICATE_BUNDLE_DEFAULT_FULL=y

# Flash 4MB
CONFIG_ESPTOOLPY_FLASHSIZE_1MB=n
CONFIG_ESPTOOLPY_FLASHSIZE_2MB=n
CONFIG_ESPTOOLPY_FLASHSIZE_4MB=y
CONFIG_ESPTOOLPY_FLASHSIZE="4MB"

# WiFi
CONFIG_ESP_WIFI_ENABLED=y
CONFIG_ESP_WIFI_STATIC_RX_BUFFER_NUM=10
CONFIG_ESP_WIFI_DYNAMIC_RX_BUFFER_NUM=32

# Event loop (bắt buộc cho wifi + mqtt)
CONFIG_ESP_EVENT_LOOP_PROFILING=n

# Netif (bắt buộc cho sntp + wifi)  
CONFIG_ESP_NETIF_LOOPBACK_NUM_OF_TASKS=1

# SNTP
CONFIG_LWIP_SNTP_MAX_SERVERS=1

# MQTT
CONFIG_MQTT_PROTOCOL_311=y
CONFIG_MQTT_TRANSPORT_SSL=y
CONFIG_MQTT_TRANSPORT_WEBSOCKET=n

# Thêm vào cuối file sdkconfig.defaults
CONFIG_LWIP_ICMP=y
CONFIG_LWIP_SNTP=y
```
